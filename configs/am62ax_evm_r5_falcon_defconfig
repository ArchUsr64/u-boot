## configs/am62ax_evm_r5_falcon_defconfig
```kconfig
#include <configs/am62ax_evm_r5_defconfig>
#include <configs/k3_r5_falcon.config>

CONFIG_SPL_FS_LOAD_ARGS_NAME="boot/dtb/ti/k3-am62a7-sk.dtb"
```

## configs/am62px_evm_r5_falcon_defconfig
```kconfig
#include <configs/am62px_evm_r5_defconfig>
#include <configs/k3_r5_falcon.config>

CONFIG_SPL_FS_LOAD_ARGS_NAME="boot/dtb/ti/k3-am62p5-sk.dtb"

# Reduce SPL size
CONFIG_LTO=y
CONFIG_SPL_YMODEM_SUPPORT=n
CONFIG_SPL_DRIVERS_MISC=n
CONFIG_SPL_SYS_MMCSD_RAW_MODE=n
CONFIG_SPL_OPTIMIZE_INLINING=y
```

## configs/am62x_evm_r5_falcon_defconfig
```kconfig
#include <configs/am62x_evm_r5_defconfig>
#include <configs/k3_r5_falcon.config>

CONFIG_SPL_FS_LOAD_ARGS_NAME="boot/dtb/ti/k3-am625-sk.dtb"
```

## configs/am62xsip_evm_r5_defconfig
```kconfig
#include <configs/am62x_evm_r5_defconfig>

CONFIG_ARM=y
CONFIG_ARCH_K3=y
CONFIG_SOC_K3_AM625=y
CONFIG_TARGET_AM625_R5_EVM=y

CONFIG_K3_OPTEE_LOAD_ADDR=0x80080000

CONFIG_DEFAULT_DEVICE_TREE="k3-am625sip-r5-sk"
```
